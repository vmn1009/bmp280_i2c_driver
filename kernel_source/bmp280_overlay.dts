/dts-v1/;
/plugin/;

/ {
    compatible = "brcm,bcm2835";

    fragment@1 {
        target-path = "/soc/i2c@7e804000";
        __overlay__ {
            #address-cells = <1>;
            #size-cells = <0>;

            bmp280_i2c_device: bmp280_i2c_device@76 {
                compatible = "bosch,bmp280";
                reg = <0x76>;
            };
        };
    };
};
